## conf/machine/omap3-multi.conf
```bitbake
#@TYPE: Machine
#@NAME: OMAP3
#@DESCRIPTION: Multi-machine configuration for beagleboard and overo

require conf/machine/include/omap3.inc

# there is no generic omap3 x-load, so just build the overo one
PREFERRED_PROVIDER_virtual/bootloader = "x-load-sakoman"
XLOAD_MACHINE = "overo_config"

# there is no generic omap3 u-boot, so just build the overo one
PREFERRED_PROVIDER_virtual/bootloader = "u-boot-sakoman"
UBOOT_MACHINE = "omap3_overo_config"

PREFERRED_PROVIDER_virtual/kernel = "linux-sakoman"

PREFERRED_PROVIDER_virtual/xserver = "xserver-xorg"
XSERVER = "xserver-xorg \
           xserver-xorg-extension-dri \
           xserver-xorg-extension-dri2 \
           xserver-xorg-extension-glx \
           xf86-input-evdev \
           xf86-input-mouse \
           xf86-input-tslib \
           xf86-video-omapfb \
           xf86-input-keyboard"

GUI_MACHINE_CLASS = "bigscreen"

IMAGE_FSTYPES += "tar.bz2"

SERIAL_CONSOLE = "115200 ttyO2"

MACHINE_EXTRA_RRECOMMENDS = " kernel-modules"
MACHINE_FEATURES = "kernel26 alsa apm ext2 screen touchscreen usbgadget usbhost vfat"
```

## conf/machine/omap4-multi.conf
```bitbake
#@TYPE: Machine
#@NAME: OMAP4
#@DESCRIPTION: Multi-machine configuration for Panda and OMAP4430SDP

require conf/machine/include/omap4.inc

# there is no generic omap4 x-load, so just build the panda one
PREFERRED_PROVIDER_virtual/bootloader = "x-load-sakoman"
XLOAD_MACHINE = "omap4430-panda_config"
XLOAD_LOAD_ADDRESS = 0x40304350

# there is no generic omap4 u-boot, so just build the panda one
PREFERRED_PROVIDER_virtual/bootloader = "u-boot-sakoman"
UBOOT_MACHINE = "omap4_panda_config"

PREFERRED_PROVIDER_virtual/kernel = "linux-sakoman"
CORTEXA8FIXUP = "no"

PREFERRED_PROVIDER_virtual/xserver = "xserver-xorg"
XSERVER = "xserver-xorg \
           xserver-xorg-extension-dri \
           xserver-xorg-extension-dri2 \
           xserver-xorg-extension-glx \
           xf86-input-evdev \
           xf86-input-mouse \
           xf86-input-tslib \
           xf86-video-omapfb \
           xf86-input-keyboard"

GUI_MACHINE_CLASS = "bigscreen"

IMAGE_FSTYPES += "tar.bz2"

SERIAL_CONSOLE = "115200 ttyO2"

MACHINE_EXTRA_RRECOMMENDS = " kernel-modules"
MACHINE_FEATURES = "kernel26 alsa apm ext2 screen touchscreen usbgadget usbhost vfat"
```

## conf/machine/omap4430-sdp.conf
```bitbake
#@TYPE: Machine
#@NAME: OMAP4430 SDP
#@DESCRIPTION: Machine configuration for the OMAP4430 SDP

require conf/machine/include/omap3.inc

PREFERRED_PROVIDER_virtual/bootloader = "x-load-sakoman"
XLOAD_MACHINE = "omap4430sdp_config"
XLOAD_LOAD_ADDRESS = 0x40304350

PREFERRED_PROVIDER_virtual/bootloader = "u-boot-sakoman"
UBOOT_MACHINE = "omap4_sdp4430_config"

PREFERRED_PROVIDER_virtual/kernel = "linux-sakoman"
PREFERRED_VERSION_linux-sakoman = "2.6.35"
CORTEXA8FIXUP = "no"

PREFERRED_PROVIDER_virtual/xserver = "xserver-xorg"
XSERVER = "xserver-xorg \
           xserver-xorg-extension-dri \
           xserver-xorg-extension-dri2 \
           xserver-xorg-extension-glx \
           xf86-input-evdev \
           xf86-input-mouse \
           xf86-input-tslib \
           xf86-video-omapfb \
           xf86-input-keyboard"

GUI_MACHINE_CLASS = "bigscreen"

IMAGE_FSTYPES += "tar.bz2"

SERIAL_CONSOLE = "115200 ttyO2"

MACHINE_EXTRA_RRECOMMENDS = " kernel-modules"
MACHINE_FEATURES = "kernel26 alsa apm ext2 screen touchscreen usbgadget usbhost vfat"
```

## conf/machine/overo.conf
```bitbake
#@TYPE: Machine
#@NAME: Overo machine
#@DESCRIPTION: Machine configuration for the Gumstix Overo

require conf/machine/include/omap3.inc

PREFERRED_PROVIDER_virtual/bootloader = "u-boot-sakoman"
UBOOT_MACHINE = "omap3_overo_config"

PREFERRED_PROVIDER_virtual/bootloader = "x-load-sakoman"
XLOAD_MACHINE = "overo_config"

PREFERRED_PROVIDER_virtual/kernel = "linux-sakoman"

PREFERRED_PROVIDER_virtual/xserver = "xserver-xorg"
XSERVER = "xserver-xorg \
           xserver-xorg-extension-dri \
           xserver-xorg-extension-dri2 \
           xserver-xorg-extension-glx \
           xf86-input-evdev \
           xf86-input-mouse \
           xf86-input-tslib \
           xf86-video-omapfb \
           xf86-input-keyboard"

GUI_MACHINE_CLASS = "bigscreen"

IMAGE_FSTYPES += "tar.bz2"

SERIAL_CONSOLE = "115200 ttyS2"

# do ubiattach /dev/ubi_ctrl -m 4
# From dmesg:
# UBI: smallest flash I/O unit:    2048
# UBI: logical eraseblock size:    129024 bytes
# from ubiattach stdout:
# UBI device number 0, total 1996 LEBs
MKUBIFS_ARGS = "-m 2048 -e 129024 -c 1996"

# do ubiattach /dev/ubi_ctrl -m 4
# from dmesg:
# UBI: smallest flash I/O unit:    2048
# UBI: physical eraseblock size:   131072 bytes (128 KiB)
# UBI: sub-page size:              512
UBINIZE_ARGS = "-m 2048 -p 128KiB -s 512"

MACHINE_EXTRA_RRECOMMENDS = " kernel-modules"
MACHINE_FEATURES = "kernel26 alsa apm ext2 screen touchscreen usbgadget usbhost vfat"
```

## contrib/sakoman/build/conf/local.conf
```bitbake
DISTRO = "angstrom-2010.x"

# Comment out *one* of the two lines below
DISTRO_TYPE = "debug"
#DISTRO_TYPE = "release"

INHERIT += "oestats-client"
OESTATS_SERVER = "build.sakoman.com"
OESTATS_BUILDER = "quadra.sakoman.com"

#
# If you enable glibc and encounter qemu-native build issues
# uncomment the line below.
ENABLE_BINARY_LOCALE_GENERATION=0

#OE_ALLOW_INSECURE_DOWNLOADS = "1"

#IMAGE_KEEPROOTFS = "1"
#INHERIT += "rm_work"

PSPLASH_LOGO = "psplash-hand-img.h-sakoman"
BOOT_SPLASH = "logo_linux_clut224-generic.ppm"

ANGSTROM_URI = "http://feeds.sakoman.com"
ANGSTROM_FEED_NAME = "gnome-r13"
```
